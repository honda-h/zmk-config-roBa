#include "roBa.dtsi"

&kscan0 {
    col-gpios
        = <&xiao_d 10 GPIO_ACTIVE_HIGH>
        , <&xiao_d 9 GPIO_ACTIVE_HIGH> 
        , <&xiao_d 8 GPIO_ACTIVE_HIGH> 
        , <&xiao_d 7 GPIO_ACTIVE_HIGH> 
        , <&gpio0 10 GPIO_ACTIVE_HIGH>
        , <&gpio0 9 GPIO_ACTIVE_HIGH>
        ;
};

/* 左エンコーダを有効化 */
&left_encoder {
    status = "okay";
};

/* * 【重要】ここでセンサーリストを「左だけ」に上書きします。
 * roBa.dtsi の記述がどうなっていようと、ここが優先されます。
 */
&sensors {
    sensors = <&left_encoder>;
};
